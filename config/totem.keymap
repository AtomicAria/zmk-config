#define CONFIG_WIRELESS
#define ZMK_BASE_LAYER(name, LT, RT, LM, RM, LB, RB, LH1, LH2, RH2, RH1)       \
    ZMK_LAYER(                                                                 \
        name,                                                                  \
        LT RT                                                                  \
        LM RM                                                                  \
        &kp ESC LB RB &kp SQT                                                  \
        &kp LGUI LH2 LH1 RH1 RH2 &kp BSPC                                            \
    )

#include "zmk-helpers/key-labels/totem.h"
#include "base.keymap"