#define CONFIG_WIRELESS
#define ZMK_BASE_LAYER(name, LT, RT, LM, RM, LB, RB, LH1, LH2, RH2, RH1)                          \
    ZMK_LAYER(                                                                                    \
        name,                                                                                     \
        &kp F1    &kp F2 &kp F3 &kp F4 &kp F5               &kp F6 &kp F7 &kp F8 &kp F9 &kp F10   \
        &kp EQUAL &kp N1 &kp N2 &kp N3 &kp N4 &kp N5 &kp N6 &kp N7 &kp N8 &kp N9 &kp N0 &kp MINUS \
        &kp TAB              LT                                            RT           &kp BSPC  \
        &kp ESC              LM                                            RM           &kp SQT   \
        &none                LB LH2  &none  &none  &none  &none RH2    RB  &none     \
                                &none  &none &none                                                \
        &kp LEFT  &kp RIGHT  LH1 &kp LGUI &none            &none &kp BSPC RH1    &kp UP &kp DOWN  \
                                                     &none  &none &none)

#include "zmk-helpers/key-labels/glove80.h"
#include "base.keymap"
